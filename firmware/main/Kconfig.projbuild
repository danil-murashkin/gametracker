## firmware/main/Kconfig.projbuild
```kconfig
menu "App"

    config APP_DISPLAY_HW_TEST_AT_BOOT
        bool "Run RGB display hardware test at boot"
        default n
        help
            Before LVGL starts, fill the screen red, green, blue (SPI/panel check).
            Normal UI runs after the test.

    config APP_DISPLAY_HW_TEST_HOLD_MS
        int "HW test color hold time (ms)"
        depends on APP_DISPLAY_HW_TEST_AT_BOOT
        default 800
        range 100 5000

endmenu
```

## firmware/sdkconfig.defaults
```kconfig
CONFIG_IDF_TARGET="esp32"

CONFIG_ESP_DEFAULT_CPU_FREQ_MHZ_240=y
CONFIG_FREERTOS_HZ=1000

# LVGL 9 — keep in sync with ../common/lvgl-target.json
CONFIG_LV_CONF_SKIP=y
CONFIG_LV_COLOR_DEPTH_16=y
CONFIG_LV_DRAW_SW_SUPPORT_RGB565=y
CONFIG_LV_DRAW_SW_SUPPORT_RGB565_SWAPPED=y
CONFIG_LV_USE_STDLIB_MALLOC=y
CONFIG_LV_USE_STDLIB_STRING=y
CONFIG_LV_USE_STDLIB_SPRINTF=y
CONFIG_LV_FONT_MONTSERRAT_14=y
CONFIG_LV_FONT_MONTSERRAT_28=y
CONFIG_LV_DEF_REFR_PERIOD=10
CONFIG_LV_USE_PERF_MONITOR=n
```
